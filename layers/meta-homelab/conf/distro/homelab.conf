## layers/meta-homelab/conf/distro/homelab.conf
```bitbake
require conf/distro/poky.conf

DISTRO = "homelab"
DISTRO_NAME = "Home Lab Linux"
DISTRO_VERSION = "0.1"

SDK_VENDOR = "-homelab"
TARGET_VENDOR = "-homelab"

PACKAGE_CLASSES ?= "package_ipk"
```
